/**
  ******************************************************************************
  * @copyright (C) COPYRIGHT  Nova
  * @file        dev_modbus.c
  * @author      Xi'an NovaStar Tech Co.,LTD.
  * @version     V1.0.0
  * @date        2025-6-1
  * @brief
  ******************************************************************************
  * @attention
  * @relation

  * @par :
  * <table>
  * <tr><th>Date          <th>Version   <th>Author      <th>Description
  * <tr><td>2025-6-1    <td>V1.0.0    <td>           <td>InitialVersion
  * </table>
  ******************************************************************************
  */

#include "dev_modbus.h"
#include "dev_communication.h"
#define LOG_TAG "dev_modbus"
#define MODBUS_RTU_REV_QUEUE_DEPTH   2
#define MODBUS_RTU_RX_SIZE       (1024*3)

static uint8_t  _gModbusSendCompleteFlag = 0;/*1表示发送完成*/
static uint8_t _Uart1RxBuf[MODBUS_RTU_RX_SIZE];//DMA接收提前把BUF定义好
static ModbusRTURevData_t _gModbusData[MODBUS_RTU_REV_QUEUE_DEPTH];
static uint8_t _RevData[MODBUS_RTU_REV_QUEUE_DEPTH][MODBUS_RTU_RX_SIZE];
static void _IrqRxProcess(void);
static void _DMATxCompleteIrqProcess(void);
Queue_t gModbusRTURevQueue;
uint8_t gBMSSleepFlag = 0;


static const uint8_t _CrcHi[] =
{
    0x00, 0xC1, 0x81, 0x40, 0x01, 0xC0, 0x80, 0x41, 0x01, 0xC0,
    0x80, 0x41, 0x00, 0xC1, 0x81, 0x40, 0x01, 0xC0, 0x80, 0x41,
    0x00, 0xC1, 0x81, 0x40, 0x00, 0xC1, 0x81, 0x40, 0x01, 0xC0,
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    0x80, 0x41, 0x00, 0xC1, 0x81, 0x40
} ;
// CRC 低字节
static const uint8_t _CrcLo[] =
{
    0x00, 0xC0, 0xC1, 0x01, 0xC3, 0x03, 0x02, 0xC2, 0xC6, 0x06,
    0x07, 0xC7, 0x05, 0xC5, 0xC4, 0x04, 0xCC, 0x0C, 0x0D, 0xCD,
    0x0F, 0xCF, 0xCE, 0x0E, 0x0A, 0xCA, 0xCB, 0x0B, 0xC9, 0x09,
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    0x43, 0x83, 0x41, 0x81, 0x80, 0x40
};

static uint16_t _CrcModbus(uint8_t *p, uint16_t len)
{
    uint8_t ucCRCHi = 0xFF; /* 高CRC字节初始化 */
    uint8_t ucCRCLo = 0xFF; /* 低CRC 字节初始化 */
    uint16_t usIndex;  /* CRC循环中的索引 */
    while (len--)
    {
        usIndex = ucCRCLo ^ *p++; /* 计算CRC */
        ucCRCLo = ucCRCHi ^ _CrcHi[usIndex];
        ucCRCHi = _CrcLo[usIndex];
    }
    return ((uint16_t)ucCRCHi << 8 | ucCRCLo);
}

static bool _CrcJudge(uint8_t *p, uint16_t len)
{
    uint16_t calc_crc, act_crc;

    act_crc = (p[len - 1] << 8) | (p[len - 2]);
    calc_crc = _CrcModbus(p, len - 2);
    if(act_crc == calc_crc)
    {
        return true;
    }
    return false;
}


void ModbusRTUSend(uint8_t *p, uint16_t size)
{
    uint16_t crc;

    Uart1_Fpga_Sofcore_Handle.pTxBuf = p;
    crc = _CrcModbus(p, size);
    Uart1_Fpga_Sofcore_Handle.pTxBuf[size] = crc & 0xFF;
    Uart1_Fpga_Sofcore_Handle.pTxBuf[size + 1] = (crc >> 8) & 0xFF;
    Uart1_Fpga_Sofcore_Handle.tx_size = size + 2;
    _gModbusSendCompleteFlag = 0;
    UartSend(&Uart1_Fpga_Sofcore_Handle);
}

void UART1ToFPGASoftcoreInit()
{
    QueueInit(&gModbusRTURevQueue, MODBUS_RTU_REV_QUEUE_DEPTH, sizeof(ModbusRTURevData_t));
    for(uint8_t i = 0; i < MODBUS_RTU_REV_QUEUE_DEPTH; i++)
    {
        _gModbusData[i].pData = _RevData[i];
    }
    Uart1_Fpga_Sofcore_Handle.pRxBuf = _Uart1RxBuf;
    Uart1_Fpga_Sofcore_Handle.rx_size = MODBUS_RTU_RX_SIZE;
    Uart1_Fpga_Sofcore_Handle.irq_rx_process = _IrqRxProcess;
    Uart1_Fpga_Sofcore_Handle.dma_tx_complete_process = _DMATxCompleteIrqProcess;
    Uart1FpgaSofcoreBspInit();
}

static void _RevDataAnalysis(uint16_t len)
{
    static uint16_t rev_index = 0;
    uint8_t *p = Uart1_Fpga_Sofcore_Handle.pRxBuf;
    if(len < 5)
    {
        return;
    }
    if((*p == REQUST_PACKET_HEAD) && (*(p + 1) == SEND_ADDR) && \
            (*(p + 2) == RECV_ADDR))//私有协议
    {
        if(QueueIsFull(&gModbusRTURevQueue) == true)
        {
            return;//扔掉此包数据
        }
        _gModbusData[rev_index].data_type = TYPE_COM_DATA;
        gBMSSleepFlag = 0;
    }
    else if(MODBUS_DEVICE_ADDR == p[0])//MODBUS协议
    {
        _gModbusData[rev_index].data_type = TYPE_MODBUS_DATA;
        if(_CrcJudge(p, len) == false)
        {
            return;
        }
        gBMSSleepFlag = 0;
    }
    else
    {
        return;
    }
    _gModbusData[rev_index].slave_addr = p[0];
    _gModbusData[rev_index].data_size = len;
    memcpy(_gModbusData[rev_index].pData, p, len);

    if(QueuePut(&gModbusRTURevQueue, &_gModbusData[rev_index]) == false)
    {
        return;
    }
    rev_index++;
    rev_index %= MODBUS_RTU_REV_QUEUE_DEPTH;
}

static void _IrqRxProcess()
{
    uint16_t rev_size = 0;
    /*DMA方式，空闲中断机制*/
    UartDMARxDisable(&Uart1_Fpga_Sofcore_Handle);
    rev_size = UartDMARxDataLength(&Uart1_Fpga_Sofcore_Handle);
    _RevDataAnalysis(rev_size);
    UartDMARxEnable(&Uart1_Fpga_Sofcore_Handle);
}

static void _DMATxCompleteIrqProcess()
{
    _gModbusSendCompleteFlag = 1;
}

static void _DMATxCompleteIrqProcess1()
{
    _gModbusSendCompleteFlag = 1;
}

bool DevModbusSendComplete()
{
    if(_gModbusSendCompleteFlag == 1 && (UartSendCompleteFlag(&Uart1_Fpga_Sofcore_Handle) == true))
    {
        _gModbusSendCompleteFlag = 0;
        return true;
    }
    else
    {
        return false;
    }
}

uint16_t BEBufToUint16(uint8_t *_pBuf)
{
    return (((uint16_t)_pBuf[0] << 8) | _pBuf[1]);
}

void TabLsbToMsb(uint8_t *str, uint16_t len)
{
    for(int j = 0; j < len / 2; j++)
    {
        str[j] ^= str[len - j - 1];
        str[len - j - 1] ^= str[j];
        str[j] ^= str[len - j - 1];
    }
}




