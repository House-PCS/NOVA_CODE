
/**
  ******************************************************************************
  * @copyright (C) COPYRIGHT  Nova
  * @file        dev_modbus_s.c
  * @author      Xi'an NovaStar Tech Co.,LTD.
  * @version     V1.0.0
  * @date        2023-5-16
  * @brief    
  ******************************************************************************
  * @attention
  * @relation
  
  * @par :
  * <table>
  * <tr><th>Date          <th>Version   <th>Author      <th>Description
  * <tr><td>2023-6-9      <td>V1.0.0       <td>        <td>InitialVersion
  * </table>
  ******************************************************************************
  */
  
#include "dev_modbus_s.h"
#include "proto_uniform.h"


#define MODBUS_RTU_REV_QUEUE_DEPTH   2
#define MODBUS_RTU_RX_SIZE       2100

static uint8_t  _gModbusSendCompleteFlag = 0;/*1表示发送完成*/
static uint32_t _gModbusSendTimeout = 0;/*用于触发DMA发送后，长时间未产生DMA完成中断的情况*/
static uint32_t _gModbusSendMaxTime = 0;/*DMA最大发送时间，由每次发送的数据量决定，增加一些冗余时间*/

//static uint8_t  _gModbusSendCompleteFlag = 0;/*1表示发送完成*/
//static uint32_t _gModbusSendTimeout = 0;/*用于触发DMA发送后，长时间未产生DMA完成中断的情况*/
//static uint32_t _gModbusSendMaxTime = 0;/*DMA最大发送时间，由每次发送的数据量决定，增加一些冗余时间*/


/*说明：针对发送是否完成，可采用DMA完成中断+串口发送寄存器空的状态判断，也可在发送前作发送时间预计算，轮询时间到了后恢复接收态，前者时间控制更精准些*/


static const uint8_t _CrcHi[] = {
    0x00, 0xC1, 0x81, 0x40, 0x01, 0xC0, 0x80, 0x41, 0x01, 0xC0,
    0x80, 0x41, 0x00, 0xC1, 0x81, 0x40, 0x01, 0xC0, 0x80, 0x41,
    0x00, 0xC1, 0x81, 0x40, 0x00, 0xC1, 0x81, 0x40, 0x01, 0xC0,
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    0x80, 0x41, 0x00, 0xC1, 0x81, 0x40
} ;
// CRC 低字节
static const uint8_t _CrcLo[] = {
	0x00, 0xC0, 0xC1, 0x01, 0xC3, 0x03, 0x02, 0xC2, 0xC6, 0x06,
	0x07, 0xC7, 0x05, 0xC5, 0xC4, 0x04, 0xCC, 0x0C, 0x0D, 0xCD,
	0x0F, 0xCF, 0xCE, 0x0E, 0x0A, 0xCA, 0xCB, 0x0B, 0xC9, 0x09,
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	0x43, 0x83, 0x41, 0x81, 0x80, 0x40
};
//

static uint8_t _Uart1RxBuf[MODBUS_RTU_RX_SIZE];//DMA接收提前把BUF定义好
    
static ModbusRTURevData_t _gModbusData[MODBUS_RTU_REV_QUEUE_DEPTH];
static uint8_t _RevData[MODBUS_RTU_REV_QUEUE_DEPTH][MODBUS_RTU_RX_SIZE];

Queue_t	gModbusMTURevQueue;

static void _IrqRxProcess();
static void _DMATxCompleteIrqProcess();

static uint16_t _CrcModbus(uint8_t *p, uint16_t len)
{
    uint8_t ucCRCHi = 0xFF; /* 高CRC字节初始化 */
	uint8_t ucCRCLo = 0xFF; /* 低CRC 字节初始化 */
	uint16_t usIndex;  /* CRC循环中的索引 */
    while (len--)
    {
		usIndex = ucCRCLo ^ *p++; /* 计算CRC */
		ucCRCLo = ucCRCHi ^ _CrcHi[usIndex];
		ucCRCHi = _CrcLo[usIndex];
    }
    return ((uint16_t)ucCRCHi << 8 | ucCRCLo);
}



static bool _CrcJudge(uint8_t *p, uint16_t len)
{
    uint16_t calc_crc, act_crc;
    
    act_crc = (p[len - 1] << 8) | (p[len - 2]);
    calc_crc = _CrcModbus(p, len - 2);
    if(act_crc == calc_crc)
    {
        return true;
    }
    return false;
}

void DevModbusRTUInit()
{
    QueueInit(&gModbusMTURevQueue, MODBUS_RTU_REV_QUEUE_DEPTH, sizeof(ModbusRTURevData_t));
    for(uint8_t i = 0; i < MODBUS_RTU_REV_QUEUE_DEPTH; i++)
	{
		_gModbusData[i].pData = _RevData[i];
	}
    gUart1ModbusHandle.pRxBuf = _Uart1RxBuf;
    gUart1ModbusHandle.rx_size = MODBUS_RTU_RX_SIZE;
    gUart1ModbusHandle.irq_rx_process = _IrqRxProcess;
	gUart1ModbusHandle.dma_tx_complete_process = _DMATxCompleteIrqProcess;
    DevModbusSlaveBspInit();
}



static void _RevDataAnalysis(uint16_t len)
{
    static uint16_t rev_index = 0;
    uint8_t *p = gUart1ModbusHandle.pRxBuf;
    if(len < 5)
    {
        return;
    }
	if((*p == REQUST_PACKET_HEAD) && (*(p + 1) == SEND_ADDR) && \
       (*(p + 2) == RECV_ADDR))
    {
		_gModbusData[rev_index].data_type = UART_DATA_TYPE_UPGRADE;
	}
	else
	{
		if(MODBUS_DEVICE_ADDR  != p[0])//不是自己的包
		{
			return;
		}
		if(_CrcJudge(p, len) == false)
		{
			return;
		}
		_gModbusData[rev_index].data_type = UART_DATA_TYPE_NORMAL;
	}
    _gModbusData[rev_index].data_size = len;
    memcpy(_gModbusData[rev_index].pData, p, len);
    
    if(QueuePut(&gModbusMTURevQueue, &_gModbusData[rev_index]) == false)
    {
        return;
    }
    rev_index++;
    rev_index %= MODBUS_RTU_REV_QUEUE_DEPTH;
    
}



static void _IrqRxProcess()
{
    uint16_t rev_size = 0;
    
	/*DMA方式，空闲中断机制*/
	UartDMARxDisable(&gUart1ModbusHandle);
	rev_size = UartDMARxDataLength(&gUart1ModbusHandle);	
    _RevDataAnalysis(rev_size);      
	UartDMARxEnable(&gUart1ModbusHandle);
}



void ModbusRTUSend(uint8_t *p, uint16_t size)
{
	if(com_revupgradedata.is_update_data == true)
	{
		uint16_t crc;
		GpioBitSet(&gGpioDirModbusHandle);         /*提前打开RS485发送信号*/

		gUart1ModbusHandle.pTxBuf = p;            /*升级包中已经进行过校验，此处不需要*/
//		crc = _CrcModbus(p, size);
//		gUart1ModbusHandle.pTxBuf[size] = crc & 0xFF; 
//		gUart1ModbusHandle.pTxBuf[size + 1] = (crc >> 8) & 0xFF;

		gUart1ModbusHandle.tx_size = size;
		_gModbusSendCompleteFlag = 0;
		_gModbusSendTimeout = tim_get_systime();
		_gModbusSendMaxTime = 1000 * (8 + 4) * gUart1ModbusHandle.tx_size / gUart1ModbusHandle.uart_cfg->baud_rate + 2;//单位ms,8表示数据位时长，4表示起始+停止+GAP时长, +2表示增加一些冗余
		UartSend(&gUart1ModbusHandle); 
	}
	else
	{
		uint16_t crc;
		GpioBitSet(&gGpioDirModbusHandle);         /*提前打开RS485发送信号*/

		gUart1ModbusHandle.pTxBuf = p;
		crc = _CrcModbus(p, size);
		gUart1ModbusHandle.pTxBuf[size] = crc & 0xFF;
		gUart1ModbusHandle.pTxBuf[size + 1] = (crc >> 8) & 0xFF;

		gUart1ModbusHandle.tx_size = size + 2;
		_gModbusSendCompleteFlag = 0;
		_gModbusSendTimeout = tim_get_systime();
		_gModbusSendMaxTime = 1000 * (8 + 4) * gUart1ModbusHandle.tx_size / gUart1ModbusHandle.uart_cfg->baud_rate + 2;//单位ms,8表示数据位时长，4表示起始+停止+GAP时长, +2表示增加一些冗余
		UartSend(&gUart1ModbusHandle);  
	}
}

static void _DMATxCompleteIrqProcess()
{
    _gModbusSendCompleteFlag = 1;
    
}
bool DevModbusSendComplete()
{
    if(GpioBitGet(&gGpioDirModbusHandle) != 0)
    {
        return false;
    }
    else
    {
        return true;
    }
}
/*大轮询调用*/
void DevModbusDirCtlProcess()
{
    if(_gModbusSendCompleteFlag == 1)
    {
        if(UartSendCompleteFlag(&gUart1ModbusHandle) == true)/*串口寄存器已经发送完成，为空*/
        {
            GpioBitReset(&gGpioDirModbusHandle);   //拉低PA0，调整为接收
            _gModbusSendCompleteFlag = 0;
        }
        else
        {
            if((uint32_t)(tim_get_systime() - _gModbusSendTimeout) > _gModbusSendMaxTime)/*发送异常，恢复接收状态*/
            {
                GpioBitReset(&gGpioDirModbusHandle);
            }
        }
    }
    else/*处理超时*/
    {
        if(GpioBitGet(&gGpioDirModbusHandle) != 0)
        {
            if((uint32_t)(tim_get_systime() - _gModbusSendTimeout) > _gModbusSendMaxTime)/*发送超时，恢复接收状态*/
            {
                GpioBitReset(&gGpioDirModbusHandle);
            }
        }
    }
}


uint16_t BEBufToUint16(uint8_t *_pBuf)
{
    return (((uint16_t)_pBuf[0] << 8) | _pBuf[1]);
}

uint16_t BEBufToUint16ToBEBuf(uint8_t *_pBuf)
{
    return (((uint16_t)_pBuf[1] << 8) | _pBuf[0]);
}













